#include <dt_bindings/zmk/matrix_transform.h>

/ {
    chosen {
        zmk,kscan = &default_kscan;
        zmk,matrix_transform = &default_transform;
    };

    default_kscan: kscan {
        compatible = "zmk,kscan-gpio-matrix";
        label = "default_kscan";
        diode-direction = "col2row";

        row-gpios = <&pro_micro xx (GPIO_ACTIVE_HIGH | GPIO_PULL_DOWN)>,
                    <&pro_micro xx (GPIO_ACTIVE_HIGH | GPIO_PULL_DOWN)>,
                    <&pro_micro xx (GPIO_ACTIVE_HIGH | GPIO_PULL_DOWN)>,
                    <&pro_micro xx (GPIO_ACTIVE_HIGH | GPIO_PULL_DOWN)>;

        col-gpios = <&pro_micro xx GPIO_ACTIVE_HIGH>,
                    <&pro_micro xx GPIO_ACTIVE_HIGH>,
                    <&pro_micro xx GPIO_ACTIVE_HIGH>,
                    <&pro_micro xx GPIO_ACTIVE_HIGH>,
                    <&pro_micro xx GPIO_ACTIVE_HIGH>,
                    <&pro_micro xx GPIO_ACTIVE_HIGH>,
                    <&pro_micro xx GPIO_ACTIVE_HIGH>,
                    <&pro_micro xx GPIO_ACTIVE_HIGH>,
                    <&pro_micro xx GPIO_ACTIVE_HIGH>,
                    <&pro_micro xx GPIO_ACTIVE_HIGH>;
    };
